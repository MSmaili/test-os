## Kconfig
```kconfig
DT_COMPAT_ZMK_BEHAVIOR_SWITCH_KEY := zmk,behavior-switch-key
config ZMK_BEHAVIOR_SWITCH_KEY
    bool
    default $(dt_compat_enabled,$(DT_COMPAT_ZMK_BEHAVIOR_SWITCH_KEY))

DT_COMPAT_ZMK_BEHAVIOR_SWITCH_KEY_SET_PRIORITY := zmk,behavior-switch-key-set-priority
config ZMK_BEHAVIOR_SWITCH_KEY_SET_PRIORITY
    bool
    default $(dt_compat_enabled,$(DT_COMPAT_ZMK_BEHAVIOR_SWITCH_KEY_SET_PRIORITY))
```

## dts/bindings/behaviors/zmk,behavior-switch-key-set-priority.yaml
```yaml
description: ZMK switch key set priority behavior
compatible: "zmk,behavior-switch-key-set-priority"
include: one_param.yaml
properties:
  "#binding-cells":
    const: 1
```

## dts/bindings/behaviors/zmk,behavior-switch-key.yaml
```yaml
description: ZMK switch key behavior
compatible: "zmk,behavior-switch-key"
include: two_param.yaml
properties:
  "#binding-cells":
    const: 2
```
